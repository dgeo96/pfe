## uClinux/linux-2.6.24.2-lpc2478-patched/drivers/ts/Kconfig
```kconfig
#
# TS configuration
#
config TS_NAMES
	bool "Touchscreen device"
	default y
	---help---
	  By default touchscreen support will be enable.

	  When in doubt, say Y.
```
